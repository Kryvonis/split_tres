## boards/shields/splitsquad/Kconfig.shield
```kconfig
config SHIELD_splitsquad_LEFT
  def_bool $(shields_list_contains,splitsquad_left)

config SHIELD_splitsquad_RIGHT
  def_bool $(shields_list_contains,splitsquad_right)
```
