## boards/shields/split_dos/Kconfig.defconfig
```kconfig
if SHIELD_SPLIT_DOS_LEFT

# Name must be less than 16 characters long!
config ZMK_KEYBOARD_NAME
    default "SplitDos"

config ZMK_SPLIT_ROLE_CENTRAL
    default y

endif

if SHIELD_SPLIT_DOS_RIGHT

config ZMK_SPLIT_ROLE_PERIPHERAL
    bool
    default y

# Right half needs to know it's the peripheral
config ZMK_KEYBOARD_NAME
    default "SplitDos R"

endif

if SHIELD_SPLIT_DOS_LEFT || SHIELD_SPLIT_DOS_RIGHT

config ZMK_SPLIT
    default y

config ZMK_SPLIT_BLE
    default y

endif
```

## boards/shields/split_dos/Kconfig.shield
```kconfig
config SHIELD_SPLIT_DOS_LEFT
  def_bool $(shields_list_contains,split_dos_left)

config SHIELD_SPLIT_DOS_RIGHT
  def_bool $(shields_list_contains,split_dos_right)
```

## boards/shields/split_tres/Kconfig.defconfig
```kconfig
if SHIELD_SPLIT_TRES_LEFT

# Name must be less than 16 characters long!
config ZMK_KEYBOARD_NAME
    default "SplitTres"

config ZMK_SPLIT_ROLE_CENTRAL
    default y

endif

if SHIELD_SPLIT_TRES_RIGHT

config ZMK_SPLIT_ROLE_PERIPHERAL
    bool
    default y

# Right half needs to know it's the peripheral
config ZMK_KEYBOARD_NAME
    default "SplitTres R"

endif

if SHIELD_SPLIT_TRES_LEFT || SHIELD_SPLIT_TRES_RIGHT

config ZMK_SPLIT
    default y

config ZMK_SPLIT_BLE
    default y

endif
```

## config/boards/shields/split_tres/Kconfig.shield
```kconfig
config SHIELD_SPLIT_TRES_LEFT
  def_bool $(shields_list_contains,split_tres_left)

config SHIELD_SPLIT_TRES_RIGHT
  def_bool $(shields_list_contains,split_tres_right)
```
